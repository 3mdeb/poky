## meta/conf/machine/qemuppc64.conf
```bitbake
#@TYPE: Machine
#@NAME: QEMU PPC64 machine (Big Endian)
#@DESCRIPTION: Machine configuration for running a PPC system on QEMU

require conf/machine/qemuppc64le.conf

# change the tune from LE to BE
DEFAULTTUNE = "ppc64p9"
```

## meta/conf/machine/qemuppc64be.conf
```bitbake
#@TYPE: Machine
#@NAME: QEMU PPC64 machine
#@DESCRIPTION: Machine configuration for running a PPC system on QEMU

require conf/machine/qemuppc64.conf

# change the tune from LE to BE
DEFAULTTUNE = "ppc64p9"
```
